/*
Andrew Kiggins
Chinmay Gopal
Yohen Thounaojam
*/
#include <LiquidCrystal.h>
const int AccPins[] = {0,0,0,0,0};
const LiquidCrystal lcd(12, 11, 5, 4, 3, 2);
const int WIFIPins[8];
String Name = "";
String MedicalInformation = "";
long AcceData = 0;
long Finder[] = {0,0,0};
#include "Wire.h" // This library allows you to communicate with I2C devices.
const int MPU_ADDR = 0x68; // I2C address of the MPU-6050. If AD0 pin is set to HIGH, the I2C address will be 0x69.
int16_t accelerometer_x, accelerometer_y, accelerometer_z; // variables for accelerometer raw data
int16_t gyro_x, gyro_y, gyro_z; // variables for gyro raw data
int16_t temperature; // variables for temperature data
char tmp_str[7]; // temporary variable used in convert function
char* convert_int16_to_str(int16_t i) { // converts int16 to string. Moreover, resulting strings will have the same length in the debug monitor.
  sprintf(tmp_str, "%6d", i);
  return tmp_str;
}

void setup() {
  Serial.begin(9600);
   Wire.begin();
      Wire.beginTransmission(MPU_ADDR); // Begins a transmission to the I2C slave (GY-521 board)
      Wire.write(0x6B); // PWR_MGMT_1 register
      Wire.write(0); // set to zero (wakes up the MPU-6050)
      Wire.endTransmission(true);
  for(int i = 0; i<(sizeof(AccPins)/sizeof(int));i++){
    pinMode(i,INPUT);
  }  
  for(int i = 0; i<(sizeof(AccPins)/sizeof(int));i++){
    pinMode(i,INPUT);
  }  
}

/*void HTTPPOSTSNS(){ //Wifi Modulo of some form is require for this.
  //https://docs.aws.amazon.com/sns/latest/dg/sns-http-https-endpoint-as-subscriber.html
  IPAddress server(10,0,0,138);
  String PostData = "someDataToPost";
  
  if (client.connect(server, 80)) {
    client.println("POST /Api/AddParking/3 HTTP/1.1");
    client.println("Host: 10.0.0.138");
    client.println("User-Agent: Arduino/1.0");
    client.println("Connection: close");
    client.print("Content-Length: ");
    client.println(PostData.length());
    client.println();
    client.println(PostData);
  }
  

} */

void DisplayInfo(){
  lcd.setCursor(0,0);
  lcd.print(Name);
  lcd.setCursor(0,1);
  lcd.print(MedicalInformation);
}

void setAccData(){ // Acceroeter is required for this function.
  if((abs(Finder[1])>=abs(Finder[0]))&&(abs(Finder[1])>=abs(Finder[2]) )){
  AcceData = Finder[1];
  }
  else{
    if((abs(Finder[0])>abs(Finder[1]))&&(abs(Finder[0])>abs(Finder[2]) )){
      AcceData = Finder[0];
    }
    else AcceData = Finder[2];
  }
}
void writingSerialWithData(){
   Wire.beginTransmission(MPU_ADDR);
      Wire.write(0x3B); // starting with register 0x3B (ACCEL_XOUT_H) [MPU-6000 and MPU-6050 Register Map and Descriptions Revision 4.2, p.40]
      Wire.endTransmission(false); // the parameter indicates that the Arduino will send a restart. As a result, the connection is kept active.
      Wire.requestFrom(MPU_ADDR, 7*2, true); // request a total of 7*2=14 registers
     
      // "Wire.read()<<8 | Wire.read();" means two registers are read and stored in the same variable
      accelerometer_x = Wire.read()<<8 | Wire.read();  // reading  registers: 0x3B (ACCEL_XOUT_H) and 0x3C (ACCEL_XOUT_L)
      accelerometer_y = Wire.read()<<8 | Wire.read(); // reading registers: 0x3D (ACCEL_YOUT_H) and 0x3E (ACCEL_YOUT_L)
      accelerometer_z = Wire.read()<<8 | Wire.read(); // reading registers: 0x3F (ACCEL_ZOUT_H) and 0x40 (ACCEL_ZOUT_L)
      temperature = Wire.read()<<8 | Wire.read(); // reading registers: 0x41 (TEMP_OUT_H) and 0x42 (TEMP_OUT_L)
      gyro_x = Wire.read()<<8 | Wire.read(); // reading registers: 0x43 (GYRO_XOUT_H) and 0x44 (GYRO_XOUT_L)
      gyro_y = Wire.read()<<8 | Wire.read(); // reading registers: 0x45 (GYRO_YOUT_H) and 0x46 (GYRO_YOUT_L)
      gyro_z = Wire.read()<<8 | Wire.read(); // reading registers: 0x47 (GYRO_ZOUT_H) and 0x48 (GYRO_ZOUT_L)
     
      // print out data
      Serial.print("aX = "); Serial.print(convert_int16_to_str(accelerometer_x));
      Serial.print(" | aY = "); Serial.print(convert_int16_to_str(accelerometer_y));
      Serial.print(" | aZ = "); Serial.print(convert_int16_to_str(accelerometer_z));
      // the following equation was taken from the documentation [MPU-6000/MPU-6050 Register Map and Description, p.30]
      Serial.print(" | tmp = "); Serial.print(temperature/340.00+36.53);
      Serial.print(" | gX = "); Serial.print(convert_int16_to_str(gyro_x));
      Serial.print(" | gY = "); Serial.print(convert_int16_to_str(gyro_y));
      Serial.print(" | gZ = "); Serial.print(convert_int16_to_str(gyro_z));
      Serial.println();
      Finder[0] = (long)accelerometer_x;
      Finder[1] = (long)accelerometer_y;
      Finder[2] = (long)accelerometer_z;
}
void loop() {
  writingSerialWithData();
   setAccData();
   if((AcceData>0)||(AcceData<(0))){ // zero is a place holder, I do not know the dangerous amount.
      //HTTPPOSTSNS();
      DisplayInfo();
   } 
   delay(1000); // creates a delay of 1 second
   
}
